## imgassembler/src/its_files/tep_fw.its
```
/*
 * The image source file creates FIT image with MXL tep-firmware.
 */

/dts-v1/;

/ {
	description = "TEP firmware binary";
	images {
		tep {
			description = "TEP firmware";
			data = /incbin/("tep_fw.bin.signed.strip");
			type = "firmware";
			arch = "X86";
			os = "tee";
			compression = "none";
			load = <0x01000000>;
			entry = <0x01000000>;
		};
	};

	configurations {
		default = "conf";
		conf {
			description = "Default configuration";
			loadables = "tep";
		};
	};
};
```

## imgassembler/src/its_files/u-boot.its
```
/dts-v1/;

/ {
    description = "U-Boot binary";
    images {
        uboot {
            description = "MXL U-Boot";
            data = /incbin/("u-boot-without-signing.lzimg.signed");
            type = "firmware";
            arch = "X86";
            os = "u-boot";
	    compression = "lzma";
            load = <0x08200000>;
            entry = <0x08200000>;
        };
    };

    configurations {
        default = "conf";
        conf {
            description = "Default configuration";
            loadables = "uboot";
        };
    };
};
```
